## CMakeLists.txt
```
# SPDX-License-Identifier: Apache-2.0

cmake_minimum_required(VERSION 3.20.0)

find_package(Zephyr REQUIRED HINTS $ENV{ZEPHYR_BASE})
project(minimal)

target_sources(app PRIVATE src/main.c)

target_compile_options(app BEFORE PRIVATE -std=gnu99)


target_include_directories(app PRIVATE
    ../build/muselab_icesugar/software/include/
    ../venv/src/litex/litex/soc/software/include/
    ../venv/src/litex/litex/soc/cores/cpu/vexriscv/
)
```

## prj.conf
```kconfig
# empty config

# gnu extensions needed for inline ASM
CONFIG_GNU_C_EXTENSIONS=y

# Boot from FLASH/ROM instead of default SRAM
CONFIG_XIP=y

# Based on regions.ld generated by LiteX
CONFIG_FLASH_BASE_ADDRESS=0x00040000
CONFIG_FLASH_SIZE=1024
CONFIG_SRAM_BASE_ADDRESS=0x10000000
CONFIG_SRAM_SIZE=64
```

## src/main.c
```c
/*
 * Copyright (c) 2019 Nordic Semiconductor ASA
 *
 * SPDX-License-Identifier: Apache-2.0
 */

#include <zephyr/kernel.h>

#include <generated/csr.h>

int main(void)
{

    // Init
    gpio2_out_write(0xFF);

    gpio2_out_write(0xFE);
    k_msleep(200);
    //gpio2_out_write(0xFD);
    k_msleep(200);

    while (1) {
        k_msleep(500);
        gpio2_out_write(0xFF);
	    printk("Hello!\n");
        k_msleep(500);
        gpio2_out_write(0xFD);
    }

	return 0;
}
```
